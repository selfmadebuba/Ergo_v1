/*
 * Copyright (c) 2021 The ZMK Contributors
 *
 * SPDX-License-Identifier: MIT
 */

#include "ergo_uzi_v1.dtsi"

&default_transform {  // The matrix transform for this board is 8 columns over because the left half is 8 columns wide according to the matrix.
    col-offset = <8>; //Furthermore, the column offset for the matrix transform should be added to the right half of the keyboard's overlay because the keyboard's switch matrix is read from left to right, top to bottom
};

&kscan0 {
    col-gpios
        = <&pro_micro 3 GPIO_ACTIVE_HIGH>   // col 8 in the schematic c8 (promicro gpio 3)
        , <&pro_micro 4 GPIO_ACTIVE_HIGH>   // col 7 in the schematic c7
        , <&pro_micro 5 GPIO_ACTIVE_HIGH>  // col 6 in the schematic c6
        , <&pro_micro 6 GPIO_ACTIVE_HIGH>  // col 5 in the schematic c5
        , <&pro_micro 7 GPIO_ACTIVE_HIGH>  // col 4 in the schematic c4
        , <&pro_micro 8 GPIO_ACTIVE_HIGH>  // col 3 in the schematic c3
        , <&pro_micro 16 GPIO_ACTIVE_HIGH> // col 2 in the schematic c2
        , <&pro_micro 14 GPIO_ACTIVE_HIGH> // col 1 in the schematic c1
        ;
};
