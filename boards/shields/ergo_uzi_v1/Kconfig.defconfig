## boards/shields/ergo_uzi_v1/Kconfig.defconfig
```kconfig
if SHIELD_ERGO_V1_LEFT

config ZMK_KEYBOARD_NAME
    default "Ergo v1"

config ZMK_SPLIT_ROLE_CENTRAL
    default y

endif

if SHIELD_ERGO_V1_LEFT || SHIELD_ERGO_V1_RIGHT

config ZMK_SPLIT
    default y

endif
```

## boards/shields/ergo_uzi_v1/Kconfig.shield
```kconfig
config SHIELD_ERGO_UZI_LEFT_V1
    def_bool $(shields_list_contains,ergo_uzi_left_v1)
	
config SHIELD_ERGO_UZI_RIGHT_V1
    def_bool $(shields_list_contains,ergo_uzi_right_v1)
```

## config/Kconfig.defconfig
```kconfig
if SHIELD_ERGO_UZI_LEFT_V1

config ZMK_KEYBOARD_NAME
    default "Ergo Uzi v1"

config ZMK_SPLIT_ROLE_CENTRAL
    default y

endif

if SHIELD_ERGO_UZI_LEFT_V1 || SHIELD_ERGO_UZI_RIGHT_V1

config ZMK_SPLIT
    default y

endif
```

## config/Kconfig.shield
```kconfig
config SHIELD_ERGO_V1_LEFT
    def_bool $(shields_list_contains,ergo_v1_left)
	
config SHIELD_ERGO_V1_RIGHT
    def_bool $(shields_list_contains,ergo_v1_right)
```
